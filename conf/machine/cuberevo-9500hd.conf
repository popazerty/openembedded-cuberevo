## conf/machine/cuberevo-9500hd.conf
```bitbake
#@TYPE: Machine
#@NAME: Cuberevo 9500 HD PVR
#@DESCRIPTION: Machine configuration for the Cuberevo 9500 HD PVR

#comment out the following two lines to use currently experimental kernel 2.6.3x
PREFERRED_VERSION_linux-cuberevo-9500hd = "2.6.23"
PREFERRED_VERSION_linux-libc-headers = "2.6.23"

PREFERRED_VERSION_madwifi-ng = "r3314-20080131"

#needed for wpa-supplicant
COMBINED_FEATURES_append = "${@base_contains('PREFERRED_VERSION_linux-cuberevo-9500hd', '2.6.23', 'madwifi', 'nl80211', d)}

#JAVA_sh4 = ",java"

#take care when you do changes on MACHINE_ESSENTIAL_EXTRA_RDEPENDS/RRECOMMENDS you have to increment the recipes/tasks/task-boot.bb PR

MACHINE_ESSENTIAL_EXTRA_RDEPENDS_2.6.23 = "\
	v4l-dvb-module-dvb-core \
"

MACHINE_ESSENTIAL_EXTRA_RRECOMMENDS_2.6.23 = "\
	kernel-module-cifs \
	kernel-module-exportfs \
	kernel-module-ext2 \
	kernel-module-reiserfs \
	kernel-module-xfs \
"

MACHINE_ESSENTIAL_EXTRA_RDEPENDS_2.6.3x = "\
	kernel-module-autofs4 \
	kernel-module-dvb-core \
	kernel-module-fb \
	kernel-module-sg \
	kernel-module-snd-pcm \
	kernel-module-snd \
	kernel-module-sr-mod \
	kernel-module-stv0299 \
	kernel-module-usbhid \
"

MACHINE_ESSENTIAL_EXTRA_RRECOMMENDS_2.6.3x = "\
	kernel-module-cdrom \
	kernel-module-cifs \
	kernel-module-exportfs \
	kernel-module-ext2 \
	kernel-module-reiserfs \
	kernel-module-xfs \
"

MACHINE_ESSENTIAL_EXTRA_RDEPENDS = ${@base_contains('PREFERRED_VERSION_linux-cuberevo-9500hd', '2.6.23', '${MACHINE_ESSENTIAL_EXTRA_RDEPENDS_2.6.23}', '${MACHINE_ESSENTIAL_EXTRA_RDEPENDS_2.6.3x}', d)}
MACHINE_ESSENTIAL_EXTRA_RRECOMMENDS = ${@base_contains('PREFERRED_VERSION_linux-cuberevo-9500hd', '2.6.23', '${MACHINE_ESSENTIAL_EXTRA_RRECOMMENDS_2.6.23}', '${MACHINE_ESSENTIAL_EXTRA_RRECOMMENDS_2.6.3x}', d)}

KERNEL_EXTRA_CMD = ${@base_contains('PREFERRED_VERSION_linux-cuberevo-9500hd', '2.6.23', '--disable-compressor=lzo ', '', d)}

EXTRA_IMAGECMD_jffs2 = " --eraseblock=0x20000 -n -l "
IMAGE_CMD_jffs2 = "\
	mkfs.jffs2 \
		--root=${IMAGE_ROOTFS}/boot \
		--faketime \
		--disable-compressor=lzo \
		--compression-mode=size \
		--output=${DEPLOY_DIR_IMAGE}/${IMAGE_NAME}.boot.jffs2 \
		${EXTRA_IMAGECMD}; \
	rm -rf ${IMAGE_ROOTFS}/boot/*; \
	mkfs.jffs2 \
		--root=${IMAGE_ROOTFS} \
		--faketime \
		${KERNEL_EXTRA_CMD} \
		--compression-mode=size \
		--output=${DEPLOY_DIR_IMAGE}/${IMAGE_NAME}.rootfs.jffs2 \
		${EXTRA_IMAGECMD}"

GLIBC_EXTRA_OECONF = "--disable-profile --with-tls --with-__thread"
TARGET_FPU = "hard"

MACHINE_FEATURES += "modem wifi"

require conf/machine/include/cuberevo-sh4.inc
```

## conf/machine/include/cuberevo-sh4.inc
```bitbake
# cuberevo-sh4.inc

MACHINE_FEATURES += "alsa pci"

#OLDEST_KERNEL = "2.6.17"
OLDEST_KERNEL = "2.6.23"

PREFERRED_PROVIDER_task-opencuberevo-dvbapi = "task-opencuberevo-dvbapi3"
PREFERRED_PROVIDER_task-opencuberevo-ui = "task-opencuberevo-enigma2"

TARGET_ARCH = "sh4"

DISTRO_FEATURES += " mplt"

require conf/machine/include/cuberevo.inc
require conf/machine/include/tune-sh4.inc
```

## conf/machine/include/cuberevo.inc
```bitbake
# cuberevo.inc

EXTRA_IMAGEDEPENDS += "u-boot"

GLIBC_ADDONS ?= "ports,nptl,libidn"
GLIBC_EXTRA_OECONF ?= "--disable-profile --with-tls --without-fp --with-__thread"

MACHINE_ESSENTIAL_EXTRA_RDEPENDS += "cuberevo-dvb-modules cuberevo-dvb-tools pcsc-lite ccid portmap openvpn openrdate fbset ffmpeg libass"
MACHINE_FEATURES += "kernel26"

PREFERRED_PROVIDER_virtual/kernel = "linux-${MACHINE}"
PREFERRED_PROVIDER_xserver = "xserver-kdrive"
```
